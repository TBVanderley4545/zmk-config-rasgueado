## config/boards/shields/rasgueado/Kconfig.defconfig
```kconfig
if SHIELD_RASGUEADO

# Name must be less than 16 characters long!
config ZMK_KEYBOARD_NAME
    default "Rasgueado"

config SPI
    default y

endif
```
